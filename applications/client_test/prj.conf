## CMakeLists.txt
```
#
# Copyright (c) 2020 Navimatix GmbH
#
# SPDX-License-Identifier: Apache-2.0
#


################################################################################

cmake_minimum_required(VERSION 3.13.1)

set(NX_SUPPORTED_BOARDS
    qemu_x86
)

set(NX_SUPPORTED_BUILD_TYPES
  ZDebug
  ZDebugWithShell
  ZRelease
)

if (NOT CMAKE_BUILD_TYPE)
  set(CMAKE_BUILD_TYPE ZRelease)
endif()

################################################################################

# Boilerplate code, which checks the given application setup.
set(CONF_FILE "prj.conf")
include(../../cmake/boilerplate.cmake)

project("LwM2M Client" VERSION 0.1)
target_sources(app PRIVATE src/main.c)
```

## prj.conf
```kconfig
#Logging
CONFIG_LOG=y
CONFIG_NET_LOG=y

#shell
CONFIG_NET_SHELL=y

#networking
CONFIG_NETWORKING=y
CONFIG_NET_IPV4=y
CONFIG_NET_IPV6=n
CONFIG_NET_TCP=y

#LWM2M config
CONFIG_LWM2M=y
CONFIG_LWM2M_COAP_BLOCK_SIZE=512
CONFIG_LWM2M_IPSO_SUPPORT=y
CONFIG_LWM2M_IPSO_PUSH_BUTTON=y
CONFIG_LWM2M_IPSO_PUSH_BUTTON_INSTANCE_COUNT=2

#App settings
CONFIG_NET_CONFIG_SETTINGS=y
CONFIG_NET_CONFIG_MY_IPV4_NETMASK="255.255.255.0"
CONFIG_NET_CONFIG_MY_IPV4_ADDR="192.0.2.1"
CONFIG_NET_CONFIG_PEER_IPV4_ADDR="192.0.2.2"
```

## src/main.c
```c
/*
 * Copyright (c) 2020 Navimatix GmbH
 *
 * SPDX-License-Identifier: Apache-2.0
 */

#include <zephyr.h>
#include <net/lwm2m.h>
#include <stdio.h>
#include <autoconf.h>

#include <logging/log.h>
LOG_MODULE_REGISTER(LwM2M_Client_Demo, LOG_LEVEL_DBG);

#define CLIENT_MANUFACTURER "Navimatix"
#define CLIENT_NAME "test_client"

#define HOST_ADDR CONFIG_NET_CONFIG_PEER_IPV4_ADDR

static struct lwm2m_ctx client;

static int cb_reboot_device(uint16_t obj_inst_id)
{
	LOG_INF("DEVICE: REBOOT");

	//insert reboot logic here....

	return 0;
}

static int basic_lwm2m_setup(void)
{
	LOG_DBG("lwm2m setup");

	//set server address
	char *addr;
	uint16_t server_url_len = 0;
	uint8_t server_url_flags = 0;
	lwm2m_engine_get_res_data("0/0/0", (void **)&addr, &server_url_len, &server_url_flags);
	sprintf(addr, "coap://%s", HOST_ADDR);
	LOG_INF("trying to connect to: %s", log_strdup(addr));

	lwm2m_engine_set_string("0/0/0", addr);

	/* Security Mode */
	lwm2m_engine_set_u8("0/0/2", 3); // no security

	// Match Security object instance ID with a Short Server ID of the Server instance
	lwm2m_engine_set_u16("0/0/10", 101); //security object instance "ID"
	lwm2m_engine_set_u16("1/0/0", 101);	 //server object instance "Short Server ID"

	//set device Mandatory data: CLIENT_MANUFACTURER
	lwm2m_engine_set_res_data("3/0/0", CLIENT_MANUFACTURER,
							  sizeof(CLIENT_MANUFACTURER),
							  LWM2M_RES_DATA_FLAG_RO);

	//set device mandatory callback: device reboot command
	lwm2m_engine_register_exec_callback("3/0/4", cb_reboot_device);

	return 0;
}

// Client event callback function
static void rd_client_event(struct lwm2m_ctx *client,
							enum lwm2m_rd_client_event client_event)
{
	switch (client_event)
	{

	case LWM2M_RD_CLIENT_EVENT_NONE:
		/* do nothing */
		break;

	case LWM2M_RD_CLIENT_EVENT_BOOTSTRAP_REG_FAILURE:
		LOG_DBG("Bootstrap registration failure!");
		break;

	case LWM2M_RD_CLIENT_EVENT_BOOTSTRAP_REG_COMPLETE:
		LOG_DBG("Bootstrap registration complete");
		break;

	case LWM2M_RD_CLIENT_EVENT_BOOTSTRAP_TRANSFER_COMPLETE:
		LOG_DBG("Bootstrap transfer complete");
		break;

	case LWM2M_RD_CLIENT_EVENT_REGISTRATION_FAILURE:
		LOG_DBG("Registration failure!");
		break;

	case LWM2M_RD_CLIENT_EVENT_REGISTRATION_COMPLETE:
		LOG_DBG("Registration complete");
		break;

	case LWM2M_RD_CLIENT_EVENT_REG_UPDATE_FAILURE:
		LOG_DBG("Registration update failure!");
		break;

	case LWM2M_RD_CLIENT_EVENT_REG_UPDATE_COMPLETE:
		LOG_DBG("Registration update complete");
		break;

	case LWM2M_RD_CLIENT_EVENT_DEREGISTER_FAILURE:
		LOG_DBG("Deregister failure!");
		break;

	case LWM2M_RD_CLIENT_EVENT_DISCONNECT:
		LOG_DBG("Disconnected");
		break;
	}
}

static uint8_t btn_val = true;
void testing_lwm2m_setup()
{
	lwm2m_engine_create_obj_inst("3347/0");
	// lwm2m_engine_create_obj_inst("3347/1");
	lwm2m_engine_set_res_data("3347/0/5500/0", &btn_val, sizeof(uint8_t), 0);
}

void main(void)
{
	LOG_INF("LwM2M client demo start....");
	basic_lwm2m_setup(); //create LWM2M resources and objects
	testing_lwm2m_setup();

	lwm2m_rd_client_start(&client, CLIENT_NAME, 0, rd_client_event); //start client

	while (1)
	{
		k_sleep(K_MSEC(1000));
		btn_val = !btn_val;
		lwm2m_engine_set_bool("3347/0/5500/0", btn_val);
		// NOTIFY_OBSERVER(3347, 0, 5500);
	}
}
```
