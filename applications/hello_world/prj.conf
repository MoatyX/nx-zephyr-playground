## CMakeLists.txt
```
#
# Copyright (c) 2020 Navimatix GmbH
#
# SPDX-License-Identifier: Apache-2.0
#


################################################################################

cmake_minimum_required(VERSION 3.13.1)

set(NX_SUPPORTED_BOARDS
  nucleo_f746zg
  qemu_x86
)

set(NX_SUPPORTED_BUILD_TYPES
  ZDebug
  ZDebugWithShell
  ZRelease
)

set(BOARD qemu_x86)

if (NOT CMAKE_BUILD_TYPE)
  set(CMAKE_BUILD_TYPE ZRelease)
endif()

################################################################################

# Boilerplate code, which checks the given application setup.
include(../../cmake/boilerplate.cmake)
project(hello_world VERSION 0.1)

# Add your source file to the "app" target. This must come after
# the boilerplate code, which defines the target.
FILE(GLOB source_files src/*.c*)
target_sources(app PRIVATE ${source_files})
```

## prj.conf
```kconfig
CONFIG_PRINTK=y         #enables using printk() to print to console
CONFIG_NETWORKING=y
```

## src/main.c
```c
/*
 * Copyright (c) 2020 Navimatix GmbH
 *
 * SPDX-License-Identifier: Apache-2.0
 */

#include <zephyr.h>
#include <sys/printk.h>
#include <autoconf.h>

void main(void) {
    printk("Hello World from %s\n", CONFIG_BOARD);
}
```
