## CMakeLists.txt
```
#
# Copyright (c) 2020 Navimatix GmbH
#
# SPDX-License-Identifier: Apache-2.0
#


################################################################################

cmake_minimum_required(VERSION 3.13.1)

set(NX_SUPPORTED_BOARDS
  qemu_x86
)

set(BOARD qemu_x86)   #TODO: remove this later. used for development purposes
set(CMAKE_BUILD_TYPE ZRelease)

set(NX_SUPPORTED_BUILD_TYPES
  ZDebug
  ZDebugWithShell
  ZRelease
)

if (NOT CMAKE_BUILD_TYPE)
  set(CMAKE_BUILD_TYPE ZRelease)
endif()

################################################################################

# Boilerplate code, which checks the given application setup.
set(CONF_FILE "prj.conf")
include(../../cmake/boilerplate.cmake)
project(lwm2m_client_cpp VERSION 0.1)

# Add your source file to the "app" target. This must come after
# the boilerplate code, which defines the target.
FILE(GLOB source_files src/*.c*)
target_sources(app PRIVATE ${source_files})
include_directories("include")
```

## prj.conf
```kconfig
#Logging
CONFIG_LOG=y
CONFIG_NET_LOG=y
CONFIG_PRINTK=y

#shell
CONFIG_NET_SHELL=y

#networking
CONFIG_NETWORKING=y
CONFIG_NET_IPV4=y
CONFIG_NET_IPV6=n
CONFIG_NET_TCP=y
CONFIG_NET_UDP=y

#LWM2M config
CONFIG_LWM2M=y
CONFIG_LWM2M_COAP_BLOCK_SIZE=512
CONFIG_LWM2M_RD_CLIENT_SUPPORT_BOOTSTRAP=y
CONFIG_LWM2M_CPP_SUPPORT=y
CONFIG_LWM2M_CPP_PUSH_BUTTON=y

#C++
# CONFIG_NEWLIB_LIBC=y
CONFIG_CPLUSPLUS=y      #enable c++ (c++11 by default)
CONFIG_LIB_CPLUSPLUS=n

#App settings
CONFIG_NET_CONFIG_SETTINGS=y
CONFIG_NET_CONFIG_MY_IPV4_NETMASK="255.255.255.0"
CONFIG_NET_CONFIG_MY_IPV4_ADDR="192.0.2.1"
CONFIG_NET_CONFIG_PEER_IPV4_ADDR="192.0.2.2"
```

## src/main.cpp
```c
/*
 * Copyright (c) 2020 Navimatix GmbH
 *
 * SPDX-License-Identifier: Apache-2.0
 */

#include <zephyr.h>
#include <autoconf.h>
#include <logging/log.h>
LOG_MODULE_REGISTER(NX_LWM2M_CPP_CLIENT, LOG_LEVEL_DBG);

#include "lwm2m_context.h"
#include "utility.h"

#include <generated_lwm2m_objects/push_button_id3347.h>

#define DEVICE_NAME CONFIG_BOARD
#define SERVER_ADDR CONFIG_NET_CONFIG_PEER_IPV4_ADDR

static void rd_client_event(struct lwm2m_ctx *client, enum lwm2m_rd_client_event client_event);

nx::lwm2m_context context(DEVICE_NAME);
nx::id3347::object push_button_obj;
nx::id3347::instance button_inst;

void *app_type_read_cb(uint16_t obj_inst_id, uint16_t res_id, uint16_t res_inst_id, size_t *data_len) {
    static char* output = "Hello Read callback!";
    *data_len = strlen(output);
    return output;
}

int inst_delete(uint16_t inst_id) {
    printk("deleting instance %d\n", inst_id);

    /* some processing.... */

    return 0;   //return 0 if all good, otherwise a negative error code from errorno.h
}

//example of binding the reboot callback of the device object (id3) to this function
int device_reboot_cb(uint16_t inst_id) {
    printk("REBOOOTING!!!\n");

    /* some processing.... */

    return 0;   //return 0 if all good, otherwise a negative error code from errorno.h
}

void main() {
    LOG_INF("LwM2M C++ Client is starting....");
    context.set_server_address(69, SERVER_ADDR);

    //set some data to the Button Instance object
    button_inst.instance_id = 0;
    button_inst.digital_input_state = false;
    button_inst.digital_input_counter = 1337;
    button_inst.set_delete_cb(inst_delete);
    push_button_obj.application_type.set_read_callback(app_type_read_cb);
    push_button_obj.register_instance(&button_inst);

    context.device_instance.manufacturer = "Navimatix";
    context.device_instance.device_type = "Zephyr LwM2M C++ Client model";
    context.device_instance.reboot = device_reboot_cb;
    context.device_instance.available_power_sources.allocate_instance(69);      //multi instance resource demo

    context.register_object(&push_button_obj);
    context.start(0, rd_client_event);
}

// Client event callback function
static void rd_client_event(struct lwm2m_ctx *client, enum lwm2m_rd_client_event client_event)
{
    switch (client_event)
    {

        case LWM2M_RD_CLIENT_EVENT_NONE:
            /* do nothing */
            break;

        case LWM2M_RD_CLIENT_EVENT_BOOTSTRAP_REG_FAILURE:
            LOG_DBG("Bootstrap registration failure!");
            break;

        case LWM2M_RD_CLIENT_EVENT_BOOTSTRAP_REG_COMPLETE:
            LOG_DBG("Bootstrap registration complete");
            break;

        case LWM2M_RD_CLIENT_EVENT_BOOTSTRAP_TRANSFER_COMPLETE:
            LOG_DBG("Bootstrap transfer complete");
            break;

        case LWM2M_RD_CLIENT_EVENT_REGISTRATION_FAILURE:
            LOG_DBG("Registration failure!");
            break;

        case LWM2M_RD_CLIENT_EVENT_REGISTRATION_COMPLETE:
            LOG_DBG("Registration complete");
            break;

        case LWM2M_RD_CLIENT_EVENT_REG_UPDATE_FAILURE:
            LOG_DBG("Registration update failure!");
            break;

        case LWM2M_RD_CLIENT_EVENT_REG_UPDATE_COMPLETE:
            LOG_DBG("Registration update complete");
            break;

        case LWM2M_RD_CLIENT_EVENT_DEREGISTER_FAILURE:
            LOG_DBG("Deregister failure!");
            break;

        case LWM2M_RD_CLIENT_EVENT_DISCONNECT:
            LOG_DBG("Disconnected");
            break;

        case LWM2M_RD_CLIENT_EVENT_QUEUE_MODE_RX_OFF:
            LOG_DBG("Queue mode RX window closed");
            break;
    }
}
```

## include/lwm2m_context.h
```c
//
// Created by moaty on 04.11.20.
//

#ifndef LWM2M_CLIENT_CPP_LWM2M_CONTEXT_H
#define LWM2M_CLIENT_CPP_LWM2M_CONTEXT_H

#include "lwm2m_cpp.h"

#include "objects.h"

#include "lwm2m_objects/device_id3.h"

namespace nx {
    class lwm2m_context {
    public:

        /**
         * @param endpoint_name[in] the name of the endpoint wished to be.
         */
        explicit lwm2m_context(const char *endpoint_name);
        ~lwm2m_context() = default;

        /**
        * @brief set a target server to connect with
        *
        * @param[in] A unique server id
        * @param[in] the IP address of the target server
        *
        */
        void set_server_address(uint16_t short_server_id, const char *server_addr);

        /**
         * @brief start a connection with a server
         * @param[in] flags: extra configuration to the lwm2m engine if needed.
         * @param[in] client_event_callback: callback to function for every client event
         */
        void start(uint32_t flags, lwm2m_ctx_event_cb_t client_event_callback);

        /**
         * try register a new lwm2m object
         * @param obj pointer to the object's class
         * @return true if registration successful
         */
        bool register_object(lwm2m_object_base* obj, bool internal_obj = false);

        /**
         * @brief unregister (delete) an object instance
         * @param obj
         * @param instance_id
         */
        void unregister_object_instance(uint16_t object_id, uint16_t instance_id);

    public:
        id3::object device;
        id3::instance device_instance;

    private:
        const char *endpoint_name;
        char *server_address;

        struct lwm2m_ctx client{};
    };
}


#endif //LWM2M_CLIENT_CPP_LWM2M_CONTEXT_H
```

## include/lwm2m_cpp.h
```c
//
// Created by moaty on 16.11.20.
//

extern "C" {
#include <net/lwm2m.h>
}

#ifndef LWM2M_CLIENT_CPP_LWM2M_CPP_H
#define LWM2M_CLIENT_CPP_LWM2M_CPP_H

#endif //LWM2M_CLIENT_CPP_LWM2M_CPP_H
```

## include/lwm2m_instance_base.h
```c
//
// Created by moaty on 09.11.20.
//

#ifndef LWM2M_CLIENT_CPP_LWM2M_INSTANCE_BASE_H
#define LWM2M_CLIENT_CPP_LWM2M_INSTANCE_BASE_H

#include <inttypes.h>
#include "lwm2m_cpp.h"

#define DEFAULT_MAX_STR_LEN 64

/**
* @brief base struct for all lwm2m instance
*/
class lwm2m_instance_base {
public:
    lwm2m_instance_base() = default;
    ~lwm2m_instance_base() = default;

    lwm2m_engine_user_cb_t  get_delete_cb();
    void set_delete_cb(lwm2m_engine_user_cb_t cb);

public:
    uint16_t instance_id;

private:
    lwm2m_engine_user_cb_t  delete_cb;
};

#endif //LWM2M_CLIENT_CPP_LWM2M_INSTANCE_BASE_H
```

## include/lwm2m_internal_objects.h
```c
//
// Created by moaty on 20.11.20.
//

#ifndef LWM2M_CLIENT_CPP_LWM2M_INTERNAL_OBJECTS_H
#define LWM2M_CLIENT_CPP_LWM2M_INTERNAL_OBJECTS_H

#endif //LWM2M_CLIENT_CPP_LWM2M_INTERNAL_OBJECTS_H
```

## include/lwm2m_object_base.h
```c
//
// Created by moaty on 09.11.20.
//

#ifndef LWM2M_CLIENT_CPP_LWM2M_OBJECT_BASE_H
#define LWM2M_CLIENT_CPP_LWM2M_OBJECT_BASE_H


#include "lwm2m_instance_base.h"
#include "lwm2m_object_resource.h"
#include <zephyr.h>

namespace nx {

    class lwm2m_object_base {
    public:
        explicit inline lwm2m_object_base(uint16_t obj_id) : object_id{obj_id} {
            current_instances_count = 0;
        }

        ~lwm2m_object_base() = default;

        bool register_instance(lwm2m_instance_base* instance);
        lwm2m_instance_base* get_instance(size_t index);

        /**
         * get a reference to all resource of a lwm2m object
         * @param[out] res_count: gives out an integer which tells how many resource the lwm2m object have
         * @return an array of pointers to all the resources a lwm2m object have
         */
        virtual lwm2m_object_resource** get_all_res(size_t* res_count) = 0;

    public:
        const uint16_t object_id;
        size_t current_instances_count;
    private:
        //Static memory allocation
#define MAX_INSTANCES   2
        lwm2m_instance_base* instances_list[MAX_INSTANCES]{nullptr};
        //=============================================================
    };
}


#endif //LWM2M_CLIENT_CPP_LWM2M_OBJECT_BASE_H
```

## include/lwm2m_object_resource.h
```c
//
// Created by moaty on 09.11.20.
//

#ifndef LWM2M_CLIENT_CPP_LWM2M_OBJECT_RESOURCE_H
#define LWM2M_CLIENT_CPP_LWM2M_OBJECT_RESOURCE_H

#include "lwm2m_instance_base.h"
#include "lwm2m_cpp.h"

namespace nx {

    /**
     * type of operations. this effects only how the bind with the internal lwm2m engine is made
     */
    typedef enum class resource_operations {
        R,
        RW,
        EXEC
    } resource_operations_t;

    typedef enum class resource_type{
        /**
         * single resource instance.
         * CAN be used with all data types EXCEPT: pointer types (char*, int*, execute types)
         * and types that are specified according to standards, as Single instance types (i.e: can have only 1 instance)
         */
        SINGLE,
        /**
         * multiple resource instance.
         * CAN be used only with types specified as Multiple instance types
         */
        MULTIPLE,
        /**
         * a single pointer type, ex: char*
         * this option effects only how pointers to the data are internally interpreted.
         * CAN only be used with pointer types (char*, int*, ...) and execute resource type
         */
        PTR
    } resource_type_t;

/**
 * @brief a struct that contains base members for each lwm2m object resource
 * @tparam res_id
 */
typedef void* lwm2m_instance_base::* member_pointer;
    class lwm2m_object_resource {
    public:
        lwm2m_object_resource(uint16_t resource_ud, resource_type_t res_type, resource_operations_t op,
                              member_pointer mem_ptr);
        ~lwm2m_object_resource() = default;

        void set_read_callback(lwm2m_engine_get_data_cb_t read_callback);
        void set_post_write_callback(lwm2m_engine_set_data_cb_t write_callback);
        lwm2m_engine_get_data_cb_t get_read_cb();
        lwm2m_engine_set_data_cb_t get_post_write_cb();

    public:
        member_pointer mem_ptr;
        uint16_t resource_id;
        resource_operations_t operation;
        resource_type_t  type;
        uint8_t user_data_flags{0};

    private:
        lwm2m_engine_get_data_cb_t read_cb {nullptr};
        lwm2m_engine_set_data_cb_t write_cb {nullptr};
        lwm2m_engine_user_cb_t  delete_cb {nullptr};
    };
}


#endif //LWM2M_CLIENT_CPP_LWM2M_OBJECT_RESOURCE_H
```

## include/multi_inst_resources.cpp
```c
//
// Created by moaty on 24.11.20.
//

#include "multi_inst_resources.h"

bool multi_inst_resource::allocate_instance(int inst_val) {
    if(current_alloc_head + 1 > DEFAULT_MAX_INST_COUNT) return false;

    instances_val[current_alloc_head] = inst_val;
    current_alloc_head++;

    return true;
}

bool multi_inst_resource::index(int i, int *out_val) {
    if(i >= DEFAULT_MAX_INST_COUNT) return false;
    *out_val = instances_val[i];
    return true;
}
```

## include/multi_inst_resources.h
```c
//
// Created by moaty on 24.11.20.
//

#ifndef LWM2M_CLIENT_CPP_MULTI_INST_RESOUCE_H
#define LWM2M_CLIENT_CPP_MULTI_INST_RESOUCE_H

#include <inttypes.h>

namespace nx {

/**
 * a class to manage multi-instance resources
 */
    template<typename T, uint16_t max_count>
    class multi_inst_resource {
    public:
        multi_inst_resource() = default;

        ~multi_inst_resource() = default;

        bool allocate_instance(T inst_val);

        //access an element by index
        bool index(int i, T *out_val);

        //access an element by index
        bool index(int i, T** out_ptr_val);
        int get_allocated_count() const;

        constexpr inline static int size() {
            return sizeof(decltype(instances_val));
        };

    private:
        int current_alloc_head = 0;
        T instances_val[max_count];
    };

    template<typename T, uint16_t max_count>
    bool multi_inst_resource<T, max_count>::allocate_instance(T inst_val) {
        if (current_alloc_head + 1 > max_count) return false;

        instances_val[current_alloc_head] = inst_val;
        current_alloc_head++;

        return true;
    }

    template<typename T, uint16_t max_count>
    bool multi_inst_resource<T, max_count>::index(int i, T *out_val) {
        if (i >= max_count) return false;
        *out_val = instances_val[i];
        return true;
    }

    template<typename T, uint16_t max_count>
    int multi_inst_resource<T, max_count>::get_allocated_count() const {
        return current_alloc_head;
    }

    template<typename T, uint16_t max_count>
    bool multi_inst_resource<T, max_count>::index(int i, T **out_ptr_val) {
        if (i >= max_count) return false;
        *out_ptr_val = &instances_val[i];
        return true;
    }
}


#endif //LWM2M_CLIENT_CPP_MULTI_INST_RESOUCE_H
```

## include/nx_string.h
```c
//
// Created by moaty on 11.11.20.
//

#ifndef LWM2M_CLIENT_CPP_STRING_H
#define LWM2M_CLIENT_CPP_STRING_H

#include <sys/util.h>
#include <string.h>

namespace nx {

    /***
     * @brief template class to help create pre-allocated strings at compile time, and make it easy to use string functions generally
     * @tparam str_len the max length of the string buffer. once buffer created, it cannot be expanded nor shrunk
     */
    template<size_t str_len>
    class string {
    public:
        string() = default;
        explicit string(const char* str);
        ~string() = default;

        const char* to_char_array() const;

        string& operator = (const char* str);

    public:
        const size_t str_length{str_len};
    private:
        char str_[str_len]{0};
    };

    template<size_t str_len>
    string<str_len>::string(const char *str) {
        memcpy(str_, str, MIN(str_length, strlen(str)));
    }

    template<size_t str_len>
    string<str_len> &string<str_len>::operator=(const char *str) {
        memcpy(str_, str, str_length);
        return *this;
    }

    template<size_t str_len>
    const char *string<str_len>::to_char_array() const {
        return str_;
    }
}


#endif //LWM2M_CLIENT_CPP_STRING_H
```

## include/objects.h
```c
//
// Created by moaty on 09.11.20.
//

#ifndef LWM2M_CLIENT_CPP_OBJECTS_H
#define LWM2M_CLIENT_CPP_OBJECTS_H

#include <errno.h>      //use this for returning standard zephyr error codes

#include "lwm2m_object_base.h"
#include "nx_string.h"
#include "multi_inst_resources.h"

namespace nx {
    typedef lwm2m_engine_user_cb_t executable;

#define MEMBER_SIZE(member) sizeof(decltype((member)))      //BUG: this will not work with pointer type resources (char*)

#define RESOURCE(id, type, op, member_ptr, resource_name)   \
    lwm2m_object_resource resource_name{(id), (type), (op), (member_ptr)}
}

#endif //LWM2M_CLIENT_CPP_OBJECTS_H
```

## include/test.h
```c
#if !defined(test_h_)
#define test_h_

namespace nx
{
    class test
    {
    private:
    public:
        test(/* args */);
        ~test();

        void doTest();
    };
} // namespace nx

#endif // test_h_
```

## include/utility.h
```c
//
// Created by moaty on 04.11.20.
//

#ifndef LWM2M_CLIENT_CPP_UTILITY_H
#define LWM2M_CLIENT_CPP_UTILITY_H

#include <stdint.h>

/**
 * @brief this header provides a set of utility methods for common lwm2m operations on the ZephyrRTOS
 * NOTE: this header has an internal buffer of length NX_UTILITY_MAX_BUFFER_SIZE to output strings,
 * so the user doesn't have to provide buffers themselves
 */

#define NX_UTILITY_MAX_BUFFER_SIZE  64

namespace nx {
    char* lwm2m_object_to_path(uint16_t obj_id, uint16_t obj_inst_id);
    char* lwm2m_object_to_path(uint16_t obj_id, uint16_t obj_inst_id, uint16_t resource_id, uint16_t resource_inst_id);
    char* lwm2m_object_to_path(uint16_t obj_id, uint16_t obj_inst_id, uint16_t resource_id);

    /**
     * quickly assign a char array some string value
     * @param src
     * @param strlen
     * @param target
     */
    void set_str(char *src, uint32_t strlen, const char *target);

    /**
     * quickly assign a char array some string value
     * @param src
     * @param target
     */
    void set_str(char *src, const char *target);

    /**
     * dump the hex values of an arbitrary address in memory. useful for quick memory debugging
     * @param desc some description
     * @param addr the target address
     * @param len the length of structure
     */
    void hex_dump (const char * desc, const void * addr, int len);
}
#endif //LWM2M_CLIENT_CPP_UTILITY_H
```
