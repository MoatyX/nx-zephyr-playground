## CMakeLists.txt
```
#
# Copyright (c) 2020 Navimatix GmbH
#
# SPDX-License-Identifier: Apache-2.0
#


################################################################################

cmake_minimum_required(VERSION 3.13.1)

set(NX_SUPPORTED_BOARDS
  qemu_x86
)

set(NX_SUPPORTED_BUILD_TYPES
  ZDebug
  ZDebugWithShell
  ZRelease
)

if (NOT CMAKE_BUILD_TYPE)
  set(CMAKE_BUILD_TYPE ZRelease)
endif()

################################################################################

# Boilerplate code, which checks the given application setup.
set(CONF_FILE "prj.conf")
include(../../cmake/boilerplate.cmake)
project(cpp_test VERSION 0.1)

# Add your source file to the "app" target. This must come after
# the boilerplate code, which defines the target.
FILE(GLOB source_files src/*.c*)
target_sources(app PRIVATE ${source_files})
include_directories("include")
```

## prj.conf
```kconfig
#Logging
CONFIG_LOG=y
CONFIG_NET_LOG=y
CONFIG_PRINTK=y

#shell
CONFIG_NET_SHELL=y

#networking
CONFIG_NETWORKING=y
CONFIG_NET_IPV4=y
CONFIG_NET_IPV6=n
CONFIG_NET_TCP=y
CONFIG_NET_UDP=y

#LWM2M config
CONFIG_LWM2M=y
CONFIG_LWM2M_COAP_BLOCK_SIZE=512
CONFIG_LWM2M_RD_CLIENT_SUPPORT_BOOTSTRAP=y

#C++
CONFIG_CPLUSPLUS=y      #enable c++ (c++11 by default)

#App settings
CONFIG_NET_CONFIG_SETTINGS=y
CONFIG_NET_CONFIG_MY_IPV4_NETMASK="255.255.255.0"
CONFIG_NET_CONFIG_MY_IPV4_ADDR="192.0.2.1"
CONFIG_NET_CONFIG_PEER_IPV4_ADDR="192.0.2.2"
```

## src/main.cpp
```c
/*
 * Copyright (c) 2020 Navimatix GmbH
 *
 * SPDX-License-Identifier: Apache-2.0
 */

#include <zephyr.h>
#include <sys/printk.h>

template<uint16_t id>
class interface
{
public:
    virtual int xx() = 0;
};

class test : public interface<100> {
public:
    virtual int xx() override {
        return 100;
    }
};


void main(void) {
    printk("Hello World! \n");

    test obj;
    obj.xx();
}
```
