## CMakeLists.txt
```
#
# Copyright (c) 2020 Navimatix GmbH
#
# SPDX-License-Identifier: Apache-2.0
#


################################################################################

cmake_minimum_required(VERSION 3.13.1)

set(NX_SUPPORTED_BOARDS
  qemu_x86
)

set(BOARD qemu_x86)

if (NOT CMAKE_BUILD_TYPE)
  set(CMAKE_BUILD_TYPE ZRelease)
endif()

################################################################################

# Boilerplate code, which checks the given application setup.
set(CONF_FILE "prj.conf")
include(../../cmake/boilerplate.cmake)
project("lwm2m_cpp_client" VERSION 0.1)

# Add your source file to the "app" target. This must come after
# the boilerplate code, which defines the target.
FILE(GLOB source_files src/*.c*)
target_sources(app PRIVATE ${source_files})
include_directories("include")
```

## prj.conf
```kconfig
#Logging
CONFIG_LOG=y
CONFIG_NET_LOG=y
CONFIG_PRINTK=y

#shell
CONFIG_NET_SHELL=y

#networking
CONFIG_NETWORKING=y
CONFIG_NET_IPV4=y
CONFIG_NET_IPV6=n
CONFIG_NET_TCP=y
CONFIG_NET_UDP=y

#LWM2M config
CONFIG_LWM2M=y
CONFIG_LWM2M_COAP_BLOCK_SIZE=512
CONFIG_LWM2M_RD_CLIENT_SUPPORT_BOOTSTRAP=y

#C++
CONFIG_CPLUSPLUS=y      #enable c++ (c++11 by default)

#App settings
CONFIG_NET_CONFIG_SETTINGS=y
CONFIG_NET_CONFIG_MY_IPV4_NETMASK="255.255.255.0"
CONFIG_NET_CONFIG_MY_IPV4_ADDR="192.0.2.1"
CONFIG_NET_CONFIG_PEER_IPV4_ADDR="192.0.2.2"
```

## src/main.cpp
```c
#include <zephyr.h>
#include <autoconf.h>
#include <logging/log.h>
LOG_MODULE_REGISTER(NX_LWM2M_CPP_CLIENT, LOG_LEVEL_DBG);

#include "objects.h"
#include "lwm2m_context.h"
#include "objects/push_button_3347.h"

#define DEVICE_NAME CONFIG_BOARD
#define SERVER_ADDR CONFIG_NET_CONFIG_PEER_IPV4_ADDR

// Client event callback function
static void rd_client_event(struct lwm2m_ctx *client,
                            enum lwm2m_rd_client_event client_event)
{
    switch (client_event)
    {

    case LWM2M_RD_CLIENT_EVENT_NONE:
        /* do nothing */
        break;

    case LWM2M_RD_CLIENT_EVENT_BOOTSTRAP_REG_FAILURE:
        LOG_DBG("Bootstrap registration failure!");
        break;

    case LWM2M_RD_CLIENT_EVENT_BOOTSTRAP_REG_COMPLETE:
        LOG_DBG("Bootstrap registration complete");
        break;

    case LWM2M_RD_CLIENT_EVENT_BOOTSTRAP_TRANSFER_COMPLETE:
        LOG_DBG("Bootstrap transfer complete");
        break;

    case LWM2M_RD_CLIENT_EVENT_REGISTRATION_FAILURE:
        LOG_DBG("Registration failure!");
        break;

    case LWM2M_RD_CLIENT_EVENT_REGISTRATION_COMPLETE:
        LOG_DBG("Registration complete");
        break;

    case LWM2M_RD_CLIENT_EVENT_REG_UPDATE_FAILURE:
        LOG_DBG("Registration update failure!");
        break;

    case LWM2M_RD_CLIENT_EVENT_REG_UPDATE_COMPLETE:
        LOG_DBG("Registration update complete");
        break;

    case LWM2M_RD_CLIENT_EVENT_DEREGISTER_FAILURE:
        LOG_DBG("Deregister failure!");
        break;

    case LWM2M_RD_CLIENT_EVENT_DISCONNECT:
        LOG_DBG("Disconnected");
        break;

    case LWM2M_RD_CLIENT_EVENT_QUEUE_MODE_RX_OFF:
        LOG_DBG("Queue mode RX window closed");
        break;
    }
}

void* digital_button_read_cb(nx::push_button_3347_inst* instance) {
    return &instance->digital_input_state;
}

void main()
{
    LOG_INF("Starting the C++ Client");
    nx::lwm2m_context context(DEVICE_NAME);
    context.set_server_address(101, SERVER_ADDR);

    /*register objects*/

    //example: push button object
    static bool push_button_state = false;
    static nx::push_button_3347 push_button_obj;
    static nx::push_button_3347_inst push_button_inst;

    //now initialise that object
    push_button_obj.digital_input_state.user_data = &push_button_state;     //provide a pointer to the data that represents this resource
    push_button_obj.digital_input_state.read_cb = reinterpret_cast<nx::read_cb_t>(&digital_button_read_cb);  //some read callback function
    push_button_obj.register_instance(&push_button_inst);                   //register the instance
    context.register_object(&push_button_obj);
    //===========================================================================

    /*start the connection*/
    context.start(0, rd_client_event);
}
```

## include/lwm2m_context.h
```c
#if !defined(LWM2M_CONTEXT_H_)
#define LWM2M_CONTEXT_H_

#include "objects.h"

extern "C" {
#include <net/lwm2m.h>
}

namespace nx
{
    /*
    * inital implementation of a c++ lwm2m_client
    * what this class DOES NOT do yet:
    *   - Support for bootstrapping
    *   - Support for DTLS connections
    */
    class lwm2m_context
    {
    public:
        lwm2m_context(const char *endpoint_name);
        ~lwm2m_context() = default;

        /**
        * @brief set a target server to connect with
        *
        * @param[in] A unique server id
        * @param[in] the IP address of the target server
        *
        */
        void set_server_address(uint16_t short_server_id, const char *server_addr);

        /**
         * @brief start a connection with a server
         * @param[in] flags: extra configuration to the lwm2m engine if needed.
         * @param[in] client_event_callback: callback to function for every client event
         */
        void start(uint32_t flags, lwm2m_ctx_event_cb_t client_event_callback);

        template<uint16_t obj_id>
        void register_object(lwm2m_object_base<obj_id>* obj);

        void delete_object(uint16_t obj_id);

    private:
        const char *endpoint_name_;
        char *server_address_;

        struct lwm2m_ctx client{};
    };
} // namespace nx

#endif // LWM2M_CONTEXT_H_
```

## include/objects.h
```c
//
// Created by moaty on 01.11.20.
//

#ifndef LWM2M_CPP_CLIENT_OBJECTS_H
#define LWM2M_CPP_CLIENT_OBJECTS_H

#include <inttypes.h>
#include <zephyr.h>

namespace nx {
    struct lwm2m_instance_base {
        uint16_t instance_id;
    };

    typedef void*(*read_cb_t)(lwm2m_instance_base* instance);

    template<uint16_t res_id>
    struct lwm2m_object_resource{
        uint16_t obj_id;
        read_cb_t read_cb;
        void* user_data;
    };

    template <uint16_t obj_id>
    struct lwm2m_object_base {
        uint16_t object_id {obj_id};
        sys_slist_t instances_list SYS_SLIST_STATIC_INIT(instances_list);

        void register_instance(lwm2m_instance_base* instance);
        void delete_instance(uint16_t id);
    };
}

#endif //LWM2M_CPP_CLIENT_OBJECTS_H
```

## src/lwm2m_context.cpp
```c
#include "lwm2m_context.h"
#include <zephyr.h>
#include <logging/log.h>
LOG_MODULE_REGISTER(NX_LWM2M_CONTEXT, LOG_LEVEL_DBG);

namespace nx
{
    lwm2m_context::lwm2m_context(const char *endpoint_name)
    {
        endpoint_name_ = endpoint_name;
    }

    void lwm2m_context::set_server_address(uint16_t short_server_id, const char *server_addr)
    {
        /*
        * later once we have a working Template. 
        * we will use member lwm2m instances to do the following steps
        */
        uint16_t server_url_len = 0;
        uint8_t server_url_flags = 0;
        lwm2m_engine_get_res_data("0/0/0", (void **)&server_address_, &server_url_len, &server_url_flags);

        // TODO: remove later to support DTLS and Bootrapping
        snprintk(server_address_, server_url_len, "coap://%s", server_addr);

        // Match Security object instance ID with a Short Server ID of the Server instance
        lwm2m_engine_set_u16("0/0/10", short_server_id); //security object instance "ID"
        lwm2m_engine_set_u16("1/0/0", short_server_id);  //server object instance "Short Server ID"
        lwm2m_engine_set_string("0/0/0", "coap://192.0.2.2");
    }

    void lwm2m_context::start(uint32_t flags, lwm2m_ctx_event_cb_t client_event_callback)
    {
        lwm2m_rd_client_start(&client, endpoint_name_, flags, client_event_callback); //start client
    }

    template<uint16_t obj_id>
    void lwm2m_context::register_object(lwm2m_object_base<obj_id> *obj) {

    }

    void lwm2m_context::delete_object(uint16_t obj_id) {

    }

} // namespace nx
```

## src/objects.cpp
```c
//
// Created by moaty on 01.11.20.
//

#include "objects.h"


namespace nx {
    template<uint16_t obj_id>
    void lwm2m_object_base<obj_id>::register_instance(lwm2m_instance_base *instance) {
//        sys_snode_t node;
//        sys_slist_append(&instances_list, nullptr);
    }

    template<uint16_t obj_id>
    void lwm2m_object_base<obj_id>::delete_instance(uint16_t id) {

    }
}
```

## src/push_button_3347.cpp
```c
//
// Created by moaty on 01.11.20.
//

#include "../include/objects/push_button_3347.h"

namespace nx {

}
```
