## applications/lwm2m_cpp_client/cmake-build-debug/Kconfig/Kconfig.soc.arch
```kconfig
osource "/home/moaty/zephyr_projects/zephyr/soc/$(ARCH)/Kconfig"
osource "/home/moaty/zephyr_projects/zephyr/soc/$(ARCH)/*/Kconfig"
```

## west.yml
```yaml
# The west manifest file for upstream Luminare blueprint.
#
# The per-installation west configuration file, .west/config, sets the
# path to the project containing this file in the [manifest] section's
# "path" variable.
#
# You are free to create your own manifest files and put them in any
# repository you want, to create your own custom Zephyr installations.
# For example, you could create a manifest file in your own out of
# tree application directory, which would pull this zephyr repository
# in as an ordinary project.
#
# You can pass your manifest repositories to west init when creating a
# new Zephyr installation. See the west documentation for more
# information.

manifest:
  defaults:
    remote: origin

  remotes:
    - name: origin
      url-base: git@github.com:MoatyX/nx-zephyr-playground.git
    - name: zephyrproject
      url-base: https://github.com/zephyrproject-rtos

  #
  # Please add items below based on alphabetical order
  projects:
    - name: hal_stm32
      path: modules/hal/stm32
      remote: zephyrproject
      repo-path: hal_stm32
      revision: dee4413253623ec575bb8b58abd56f91afe903bb
    - name: zephyr
      path: zephyr
      west-commands: scripts/west-commands.yml
      remote: zephyrproject
      repo-path: zephyr
      revision: zephyr-v2.4.0

  self:
    path: nx-zephyr-playground
```
